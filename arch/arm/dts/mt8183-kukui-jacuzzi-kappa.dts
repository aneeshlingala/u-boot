// SPDX-License-Identifier: GPL-2.0 OR MIT
/*
 * Copyright (C) 2023 Aneesh Lingala
 * Aneesh Lingala <aneeshlingala61@gmail.com>
 */

/dts-v1/;
#include "mt8183-kukui-jacuzzi.dtsi"
#include "mt8183-kukui-audio-ts3a227e-max98357a.dtsi"

/ {
	model = "Google kappa board";
	compatible = "google,kappa", "mediatek,mt8183";
};

&mt6358codec {
	mediatek,dmic-mode = <1>; /* one-wire */
};
